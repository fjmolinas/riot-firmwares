## boards/enviro-samr21/Kconfig
```kconfig
# Copyright (c) 2021 Inria
#
# This file is subject to the terms and conditions of the GNU Lesser
# General Public License v2.1. See the file LICENSE in the top level
# directory for more details.

config BOARD
    default "enviro-samr21" if BOARD_ENVIRO_SAMR21
    select BOARD_SAMR21_XPRO

source ${TREEBASE}/RIOT/boards/samr21-xpro/Kconfig
```

## drivers/sm_pwm_01c/Kconfig
```kconfig
# Copyright (c) 2021 Inria
#
# This file is subject to the terms and conditions of the GNU Lesser
# General Public License v2.1. See the file LICENSE in the top level
# directory for more details.
#
menuconfig KCONFIG_USEMODULE_SM_PWM_01C
    bool "Configure SM_PWM_01C driver"
    depends on USEMODULE_SM_PWM_01C
    help
        Configure the SM_PWM_01C driver using Kconfig.

if KCONFIG_USEMODULE_SM_PWM_01C

config SM_PWM_01C_WINDOW_TIME
    int "Measuring Window length"
    default 10000000
    help
        Length in time of the measuring window in microseconds,
        recommended 5-30s.

config SM_PWM_01C_SAMPLE_TIME
    int "PWM occupancy sampling period"
    default 100000
    help
        Time, expressed in microseconds, at witch LPO is occupancy is
        sampled and converted into particle matter concentration

if !USEMODULE_SM_PWM_01C_MA

config SM_PWM_01C_EXP_WEIGHT
    int "Weight of the exponential"
    default 100000
    help
        Weight of the exponential average filter where:
        SM_PWM_01C_EXP_WEIGHT = 1 / (1 - alpha).

        Should be chosen wisely, it can be done my minimizing MSE
        or other algorithms as Marquardt procedure.

endif # USEMODULE_SM_PWM_01C_MA

endif # KCONFIG_USEMODULE_SM_PWM_01C
```

## modules/coap_common/Kconfig
```kconfig
# Copyright (c) 2021 Inria
#
# This file is subject to the terms and conditions of the GNU Lesser
# General Public License v2.1. See the file LICENSE in the top level
# directory for more details.
#
menuconfig KCONFIG_USEMODULE_COAP_COMMON
    bool "Configure coap common module"
    depends on USEMODULE_COAP_COMMON
    help
        Configuration for the coap_common module

if KCONFIG_USEMODULE_COAP_COMMON

config CONFIG_NAME_RESOURCE_STR
    string "Name or Application name to expose as the COAP /name resource"
    default "riotfp"

endif # KCONFIG_USEMODULE_COAP_COMMON
```

## modules/coap_utils/Kconfig
```kconfig
# Copyright (c) 2021 Inria
#
# This file is subject to the terms and conditions of the GNU Lesser
# General Public License v2.1. See the file LICENSE in the top level
# directory for more details.
#
menuconfig KCONFIG_USEMODULE_COAP_UTILS
    bool "Configure Coap gateway common configurations"
    depends on USEMODULE_COAP_UTILS
    help
        "Configure Coap gateway common configurations using kconfig

if KCONFIG_USEMODULE_COAP_UTILS

config GATEWAY_ADDR
    string "Coap Gateway Address"
    default "fd00:dead:beef::1"

config GATEWAY_PORT
    int "Coap Gateway Port Size"
    default 5685

endif # KCONFIG_USEMODULE_COAP_UTILS
```

## modules/schedreg/Kconfig
```kconfig
# Copyright (c) 2021 Inria
#
# This file is subject to the terms and conditions of the GNU Lesser
# General Public License v2.1. See the file LICENSE in the top level
# directory for more details.
#
menuconfig KCONFIG_USEMODULE_SCHEDREG
    bool "Configure Scheduler Register"
    depends on USEMODULE_SCHEDREG
    help
        Configure Scheduler Register module using kconfig

if KCONFIG_USEMODULE_SCHEDREG

config SCHED_REG_TYPE
    hex "Sched reg message type offset"
    default 0xC00
    range 0x00 0xFFF

config SCHEDREG_QUEUE_SIZE
    int "Message queue size"
    default 4

endif # KCONFIG_USEMODULE_SCHEDREG
```
